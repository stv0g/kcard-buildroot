## configs/wifisd_defconfig
```kconfig
BR2_arm=y
BR2_KERNEL_HEADERS_VERSION=y
BR2_DEFAULT_KERNEL_VERSION="2.6.32.26"
BR2_TOOLCHAIN_BUILDROOT_INET_IPV6=y
BR2_ROOTFS_OVERLAY="board/wifisd/fs-overlay"
BR2_ROOTFS_POST_BUILD_SCRIPT="board/wifisd/post-build.sh"
BR2_ROOTFS_POST_IMAGE_SCRIPT="board/wifisd/post-image.sh"
BR2_PACKAGE_BUSYBOX_CONFIG="board/wifisd/busybox-1.21.x.config"
BR2_PACKAGE_LUA=y
BR2_PACKAGE_LUA_INTERPRETER_READLINE=y
BR2_PACKAGE_LUACJSON=y
BR2_PACKAGE_LUAEXPAT=y
BR2_PACKAGE_LUAPOSIX=y
BR2_PACKAGE_XAVANTE=y
BR2_PACKAGE_ZLIB=y
BR2_PACKAGE_DHCPCD=y
BR2_PACKAGE_DROPBEAR=y
BR2_PACKAGE_HOSTAPD=y
BR2_PACKAGE_IPTABLES=y
BR2_PACKAGE_IW=y
BR2_PACKAGE_RSYNC=y
BR2_PACKAGE_DTACH=y
BR2_TARGET_ROOTFS_CPIO=y
BR2_TARGET_ROOTFS_CPIO_GZIP=y
```
